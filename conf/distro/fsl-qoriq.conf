## conf/distro/fsl-qoriq.conf
```bitbake
# FSL distro for QorIQ SDK

require conf/distro/poky.conf

DISTRO = "fsl-qoriq"
DISTRO_NAME = "QorIQ SDK (FSL Reference Distro)"
SDK_VENDOR = "-fsl"
MAINTAINER = "Zhenhua Luo <zhenhua.luo@nxp.com>"

TARGET_VENDOR = "-fsl"

# Customize the DISTRO_FEATURES for QorIQ platforms
POKY_DEFAULT_DISTRO_FEATURES_remove = " ptest"
DISTRO_FEATURES_DEFAULT_remove = " pcmcia 3g"
DISTRO_FEATURES_DEFAULT_append = " benchmark vfat ext2 mtd pam \
    alsa pulseaudio perl ppp python usbhost virtualization db"

# When meta-openenbedded layer is included, bitbake will complain that
# multiple providers are available for jpeg (jpeg, libjpeg-turbo).
PREFERRED_PROVIDER_jpeg ?= "jpeg"
PREFERRED_PROVIDER_jpeg-native ?= "jpeg-native"

QEMU_TARGETS_append_pn-qemu-native = " ppc64"

# Set the preferred provider of some native java packages which can support
# QorIQ targets well.
PREFERRED_PROVIDER_virtual/java-initial-native = "cacao-initial-native"
PREFERRED_PROVIDER_virtual/java-native = "jamvm-native"
PREFERRED_PROVIDER_virtual/javac-native = "ecj-bootstrap-native"

# whitelist restricted license to ensure netperf can be included in QorIQ
# demo images by default.
LICENSE_FLAGS_WHITELIST = "non-commercial_netperf commercial_lame"
```
